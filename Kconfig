## Kconfig
```kconfig
config CUSTOM_CALCULATOR
    bool "Enable custom calculator module with OLED display"
    default n
    depends on ZMK_DISPLAY
    help
      Enables the on-board calculator mode. Requires an SSD1306
      OLED display connected via I2C. When active, key presses
      are routed through the calculator engine and formulas are
      rendered on screen.
```

## boards/shields/breadboard_test/Kconfig.defconfig
```kconfig
if SHIELD_BREADBOARD_TEST

config ZMK_KEYBOARD_NAME
    default "CalcPad"

config CUSTOM_CALCULATOR
    default y

config LV_Z_VDB_SIZE
    default 64

config LV_DPI_DEF
    default 148

config LV_FONT_UNSCII_8
    default y

endif
```

## boards/shields/breadboard_test/Kconfig.shield
```kconfig
config SHIELD_BREADBOARD_TEST
    def_bool $(shields_list_contains,breadboard_test)
```

## dts/bindings/behaviors/zmk,behavior-calc.yaml
```yaml
description: Calculator behavior for on-board calculator mode
compatible: "zmk,behavior-calc"
include: one_param.yaml
```
